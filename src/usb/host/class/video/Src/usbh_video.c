// UVC HOST video capture for STM32 by ILIASAM
// Search for "GRXFSIZ" to change RX FIFO size
// See mor info at "usbh_video_stram_parsing.c" file

/* Includes ------------------------------------------------------------------*/
#include "usbh_video.h"
#include "usbh_video_desc_parsing.h"
#include "usbh_video_stream_parsing.h"
#include "usbh_enum.h"
#include "usbh_pipe.h"
#include "usbh_transc.h"
#include "drv_usb_hw.h"

#include "tcp_server.h"

usb_core_driver usbh_core;
usbh_host usb_host_uvc;
ApplicationTypeDef Appli_state = APPLICATION_IDLE;

static usbh_status  USBH_VIDEO_InterfaceInit  (usbh_host  *phost);
static void  USBH_VIDEO_InterfaceDeInit  (usbh_host *phost);
static usbh_status  USBH_VIDEO_SOFProcess(usbh_host *phost);
static usbh_status  USBH_VIDEO_ClassRequest(usbh_host *phost);
static usbh_status  USBH_VIDEO_CSRequest(usbh_host *phost, uint8_t feature,uint8_t channel);                                                                                           
//static usbh_status  USBH_VIDEO_ProcessDummy(usbh_host *phost);
static usbh_status  USBH_VIDEO_HandleCSRequest(usbh_host *phost);

//static usbh_status  USBH_VIDEO_InputStream(usbh_host *phost);
static int USBH_VIDEO_InputStream (usbh_host *phost);

usbh_class  VIDEO_Class = 
{
//  "VIDEO",
  CC_VIDEO,
  USBH_VIDEO_InterfaceInit,
  USBH_VIDEO_InterfaceDeInit,
  USBH_VIDEO_ClassRequest,
  USBH_VIDEO_Process, //BgndProcess
  //USBH_VIDEO_ProcessDummy,
  USBH_VIDEO_SOFProcess,
  NULL,
};

// This struct is used for PROBE control request ( Setup Packet )
VIDEO_ProbeTypedef ProbeParams;
//VIDEO_HandleTypeDef VIDEO_Handle;
//Buffer to store received UVC data packet
volatile uint8_t tmp_packet_framebuffer[UVC_RX_FIFO_SIZE_LIMIT];

volatile uint8_t cur_index,send_index;
uint8_t start_flag,finish_flag;
uint16_t data_length,send_length;

#define PIC_SIZE     28672
uint8_t picture_data[2][PIC_SIZE] __attribute__((at(0x10000100)));

static int cnt = 0 ;
#define NUM   1000

const uint32_t exposure_val[] = {
        [0] = 1,      //PGA = 1 -13
        [1] = 2,
        [2] = 5,
        [3] = 10,
        [4] = 20,
        [5] = 39,     //PGA = 64
        [6] = 78,    //PGA = 128
        [7] = 156,
        [8] = 312,
        [9] = 625,
        [10] = 1250,     //PGA = 64
        [11] = 2047,    //PGA = 128  -2
};



//char send[] = {0x0D,0x0A,0x2D,0x2D,0x62,0x6F,0x75,0x6E,0x64,0x61,0x72,0x79,0x64,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0xFF,0xD9};
/** @defgroup Private_Functions
  * @{
  */ 


/**
  * @brief  USBH_VIDEO_InterfaceInit 
  *         The function init the Video class.
  * @param  phost: Host handle
  * @retval USBH Status
  */
static usbh_status USBH_VIDEO_InterfaceInit (usbh_host  *phost)
{
  usbh_status status = USBH_FAIL ;
  usbh_status out_status ;    
  uint8_t  interface, index;
  
  uint16_t ep_size_in = 0;  
  
    interface = usbh_interface_find(&phost->dev_prop, CC_VIDEO, USB_SUBCLASS_VIDEOCONTROL, 0x00);
  
  if(interface == 0xFF) /* Not Valid Interface */
  {
    //USBH_ErrLog("Cannot Find the interface for %s class.", phost->pActiveClass->Name);
    status = USBH_FAIL;      
  }
  else
  {
         static VIDEO_HandleTypeDef VIDEO_Handle;
     memset((void*)&VIDEO_Handle, 0U, sizeof(VIDEO_HandleTypeDef));    
     phost->active_class->class_data = (void *)&VIDEO_Handle;
//     usbh_interface_select(&phost->dev_prop, interface);
              
    /* 1st Step:  Find IN Video Interfaces */
    out_status = USBH_VIDEO_FindStreamingIN(phost);
    
    if(out_status == USBH_FAIL)
    {
//      USBH_UsrLog("%s class configuration not supported.", phost->pActiveClass->Name);
      status = USBH_FAIL;
      return USBH_FAIL;
    }
    
    /* 2nd Step:  Select Video Streaming Interfaces with best endpoint size*/ 
    for (index = 0; index < VIDEO_MAX_VIDEO_STD_INTERFACE; index++)
    {      
      if( VIDEO_Handle.stream_in[index].valid == 1)
      {
        uint16_t ep_size = VIDEO_Handle.stream_in[index].EpSize;
        //if (ep_size == 512)
        if ((ep_size > ep_size_in) && (ep_size < UVC_RX_FIFO_SIZE_LIMIT))
        {
          ep_size_in = ep_size;
          VIDEO_Handle.camera.interface = VIDEO_Handle.stream_in[index].interface;
          VIDEO_Handle.camera.AltSettings = VIDEO_Handle.stream_in[index].AltSettings;                
          VIDEO_Handle.camera.Ep = VIDEO_Handle.stream_in[index].Ep;
          VIDEO_Handle.camera.EpSize = VIDEO_Handle.stream_in[index].EpSize;
          VIDEO_Handle.camera.Poll = VIDEO_Handle.stream_in[index].Poll;         
          VIDEO_Handle.camera.supported = 1;    
        }
      }
    }
   // USBH_DbgLog("Selected EP size: %d bytes", ep_size_in);
    
    
    /* 3rd Step:  Find and Parse Video interfaces */ 
    USBH_VIDEO_ParseCSDescriptors(phost);
    
    /* 4rd Step:  Find desrcroptors for target settings */
    USBH_VIDEO_AnalyseFormatDescriptors(&VIDEO_Handle.class_desc);
    if (USBH_VIDEO_Best_bFormatIndex == -1)
    {
      status = USBH_FAIL;
      return USBH_FAIL;
    }
    
    USBH_VIDEO_AnalyseFrameDescriptors(&VIDEO_Handle.class_desc);
    if (USBH_VIDEO_Best_bFrameIndex == -1)
    {
      status = USBH_FAIL;
      return USBH_FAIL;
    }
    
    if(VIDEO_Handle.camera.supported == 1)
    {       
      //VIDEO_Handle.camera.Pipe = USBH_AllocPipe(phost, VIDEO_Handle->camera.Ep);
          //VIDEO_Handle.camera.Pipe = usbh_pipe_allocate (&usbh_core, VIDEO_Handle.camera.Ep);
      
      //VIDEO_Handle.camera.Pipe = usbh_pipe_allocate ((usb_core_driver *)phost->data, VIDEO_Handle.camera.Ep);
      
      VIDEO_Handle.camera.Pipe = usbh_pipe_allocate (&usbh_core, VIDEO_Handle.camera.Ep);
    
      /* Open pipe for IN endpoint */
    
      usbh_pipe_create ((usb_core_driver *)phost->data,
                          &phost->dev_prop,  //&usb_host_uvc.dev_prop
                          VIDEO_Handle.camera.Pipe,
                          USB_EPTYPE_ISOC,  
                          1000);
                            
      usbh_pipe_toggle_set (&usbh_core, VIDEO_Handle.camera.Pipe, 0U);

    }
    
    VIDEO_Handle.req_state     = VIDEO_REQ_INIT;
    VIDEO_Handle.control_state = VIDEO_CONTROL_INIT;
    
    status = USBH_OK;
  }
  return status;
}


/**
  * @brief  USBH_VIDEO_InterfaceDeInit 
  *         The function DeInit the Pipes used for the Video class.
  * @param  phost: Host handle
  * @retval USBH Status
  */
void USBH_VIDEO_InterfaceDeInit(usbh_host  *phost)
{
  VIDEO_HandleTypeDef *VIDEO_Handle = (VIDEO_HandleTypeDef *) phost->active_class->class_data; 
  
  if(VIDEO_Handle->camera.Pipe != 0x00)
  {
//    USBH_ClosePipe  (phost, VIDEO_Handle->camera.Pipe);
//    USBH_FreePipe  (phost, VIDEO_Handle->camera.Pipe);
    usbh_pipe_free ((usb_core_driver *)phost->data, VIDEO_Handle->camera.Pipe);
    VIDEO_Handle->camera.Pipe = 0;     /* Reset the pipe as Free */  
  }
  
  if(phost->active_class->class_data)
  {
    //USBH_free (phost->active_class->class_data);
    phost->active_class->class_data = 0;
  }  
}

/**
  * @brief  USBH_VIDEO_ClassRequest 
  *         The function is responsible for handling Standard requests
  *         for Video class.
  * @param  phost: Host handle
  * @retval USBH Status
  */
static usbh_status USBH_VIDEO_ClassRequest(usbh_host  *phost)
{   
//  static int cnt = 0 ;
  VIDEO_HandleTypeDef *VIDEO_Handle = (VIDEO_HandleTypeDef *)phost->active_class->class_data;  
  usbh_status status = USBH_BUSY;
  usbh_status req_status = USBH_BUSY;
  
  /* Switch VIDEO REQ state machine */
  switch (VIDEO_Handle->req_state)
  {
  case VIDEO_REQ_INIT:
  case VIDEO_REQ_SET_DEFAULT_IN_INTERFACE:
    if(VIDEO_Handle->camera.supported == 1)
    {
      req_status = usbh_setinterface (phost, VIDEO_Handle->camera.interface, 0);
      
      if(req_status == USBH_OK)
      { 
        VIDEO_Handle->req_state = VIDEO_REQ_SET_IN_INTERFACE;        
      }
    }
    else
    {
      VIDEO_Handle->req_state = VIDEO_REQ_SET_DEFAULT_IN_INTERFACE;//???
#if (USBH_USE_OS == 1)
      osMessagePut ( phost->os_event, USBH_URB_EVENT, 0);
#endif       
    }
    break;
    
  case VIDEO_REQ_CS_REQUESTS:
    if(USBH_VIDEO_HandleCSRequest(phost) == USBH_OK)
    {
      VIDEO_Handle->req_state = VIDEO_REQ_SET_IN_INTERFACE;
    }
    break;
   
  case VIDEO_REQ_SET_IN_INTERFACE:
    if(VIDEO_Handle->camera.supported == 1)
    {
//      req_status = USBH_SetInterface(phost, VIDEO_Handle->camera.interface,VIDEO_Handle->camera.AltSettings);                                                                                
      req_status = usbh_setinterface (phost, VIDEO_Handle->camera.interface, VIDEO_Handle->camera.AltSettings);
      
      if(req_status == USBH_OK)
      {
             VIDEO_Handle->req_state = VIDEO_REQ_SET_IN_INTERFACE;
            VIDEO_Handle->req_state = VIDEO_REQ_IDLE;
           VIDEO_Handle->steam_in_state = VIDEO_STATE_START_IN;        
      }
    }
    else
    {
      VIDEO_Handle->req_state = VIDEO_REQ_SET_IN_INTERFACE;
#if (USBH_USE_OS == 1)
      osMessagePut ( phost->os_event, USBH_URB_EVENT, 0);
#endif       
    }
    break;

  case VIDEO_REQ_IDLE:
    //phost->pUser(phost, HOST_USER_CLASS_ACTIVE); 
    USBH_UserProcess(phost, HOST_USER_CLASS_ACTIVE);
    status  = USBH_OK;    
#if (USBH_USE_OS == 1)
      osMessagePut ( phost->os_event, USBH_CLASS_EVENT, 0);
#endif
  default:
    break;
  }
  return status; 
}

/**
  * @brief  USBH_VIDEO_CSRequest 
  *         The function is responsible for handling AC Specific requests for a specific feature and channel
  *         for Video class.
  * @param  phost: Host handle
  * @retval USBH Status
  */
static usbh_status USBH_VIDEO_CSRequest(usbh_host  *phost, uint8_t feature, uint8_t channel)
{   
  usbh_status status = USBH_BUSY;

  return status; 
}

/**
  * @brief  USBH_VIDEO_HandleCSRequest 
  *         The function is responsible for handling VC Specific requests for a all features 
  *         and associated channels for Video class.
  * @param  phost: Host handle
  * @retval USBH Status
  */
static usbh_status USBH_VIDEO_HandleCSRequest(usbh_host  *phost)
{ 

  usbh_status status = USBH_BUSY;
  usbh_status cs_status = USBH_BUSY;
  VIDEO_HandleTypeDef *VIDEO_Handle =  (VIDEO_HandleTypeDef *) phost->active_class->class_data;  
        
  cs_status = USBH_VIDEO_CSRequest(phost, 
                                   VIDEO_Handle->temp_feature, 
                                   0);
  
  printf("VIDEO_Handle->temp_feature = %d \r\n",VIDEO_Handle->temp_feature);
  if(cs_status != USBH_BUSY)
  {        
  }
  
  return status;
}

//Used because of USN HOST HAL need it (BgndProcess)
//static usbh_status USBH_VIDEO_ProcessDummy(usbh_host *phost)
//{
//  return USBH_OK ;
//}

/**
  * @brief  USBH_VIDEO_Process 
  *         The function is for managing state machine for Video data transfers 
            MUST be called frequently!
  * @param  phost: Host handle
  * @retval USBH Status
  */
int USBH_VIDEO_Process(usbh_host *phost)
{   
  int status = 0;
  VIDEO_HandleTypeDef *VIDEO_Handle =  (VIDEO_HandleTypeDef *)  phost->active_class->class_data;
  
  if(VIDEO_Handle->camera.supported == 1)
  {
     status = USBH_VIDEO_InputStream(phost);
  }
 
  return status;
}

/**
  * @brief  Handle Input stream process
  * @param  phost: Host handle
  * @retval USBH Status
  */
#if 1
static int USBH_VIDEO_InputStream (usbh_host *phost)
{
  // Called from USB_HOST_fast_class_call
  //static BaseType_t xHigherPriorityTaskWoken;
  int status = 0;
  VIDEO_HandleTypeDef *VIDEO_Handle =  (VIDEO_HandleTypeDef*) phost->active_class->class_data;
  usb_urb_state result;
  
  switch(VIDEO_Handle->steam_in_state)
  {
    case VIDEO_STATE_START_IN:
      usbh_data_recev (&usbh_core, (uint8_t*)tmp_packet_framebuffer,  VIDEO_Handle->camera.Pipe,1000);   //VIDEO_Handle->camera.EpSize
      VIDEO_Handle->steam_in_state = VIDEO_STATE_DATA_IN;
    break; 
    case VIDEO_STATE_DATA_IN:    
//      result = USBH_LL_GetURBState(phost, VIDEO_Handle->camera.Pipe);    VIDEO_Handle->camera.Pipe    
       result = usbh_urbstate_get (&usbh_core, VIDEO_Handle->camera.Pipe);
        
      if((result == URB_DONE) && ((phost->control.timer - VIDEO_Handle->camera.timer) >= VIDEO_Handle->camera.Poll))
      {
        VIDEO_Handle->camera.timer = phost->control.timer;    
        
        volatile uint32_t rxlen = usbh_xfercount_get (&usbh_core, VIDEO_Handle->camera.Pipe);         // picture_data[2][10240]
                  
        if (rxlen > 12)
        {
            if ( 0 == start_flag )
            {
                if (( 0xff == tmp_packet_framebuffer[12] )&& ( 0xd8 == tmp_packet_framebuffer[13] ))  
                {
                    data_length = 0 ;
                    start_flag = 1 ;
                    memcpy(&picture_data[cur_index][data_length],(void *)&tmp_packet_framebuffer[12],rxlen-12);
                    data_length = rxlen-12 ;
                }
            }
            else
            {
                  memcpy(&picture_data[cur_index][data_length],(void *)&tmp_packet_framebuffer[12],rxlen-12);
              
                  data_length +=  rxlen-12;
              
                  if (data_length > 20000)
                  {
                      data_length = 0 ;
                      start_flag = 0 ;
                      cur_index = 0 ;
                  }
              
                  if ((0xff == tmp_packet_framebuffer[rxlen-2])&&(0xd9 == tmp_packet_framebuffer[rxlen-1]))
                  {
                      finish_flag = 1 ;
                      send_length = data_length ;
                      send_index = cur_index ;
                      start_flag = 0 ;
                                        
                      if ( 0 == cur_index)
                        cur_index = 1;
                      else
                        cur_index = 0 ;
                      
                        status = 1;
                  }
                 if (( 0xff == tmp_packet_framebuffer[12] )&& ( 0xd8 == tmp_packet_framebuffer[13] )) 
                  {
                    data_length = 0 ;
                    memcpy(&picture_data[cur_index][data_length],(void *)&tmp_packet_framebuffer[12],rxlen-12);
                    data_length = rxlen-12 ;                  
                  }                                
            }        
        }
                 
        usbh_data_recev (&usbh_core, (uint8_t*)tmp_packet_framebuffer, VIDEO_Handle->camera.Pipe,1000);
        
      }
    break;
    
    default:
      break;
  }
   
  return status;  
}
#else
static usbh_status USBH_VIDEO_InputStream (usbh_host *phost)
{
  // Called from USB_HOST_fast_class_call
  static BaseType_t xHigherPriorityTaskWoken;
  usbh_status status = USBH_BUSY;
  VIDEO_HandleTypeDef *VIDEO_Handle =  (VIDEO_HandleTypeDef*) phost->active_class->class_data;
  usb_urb_state result;
  
  switch(VIDEO_Handle->steam_in_state)
  {
    case VIDEO_STATE_START_IN:
      usbh_data_recev (&usbh_core, (uint8_t*)tmp_packet_framebuffer,  VIDEO_Handle->camera.Pipe,1000);   //VIDEO_Handle->camera.EpSize
      VIDEO_Handle->steam_in_state = VIDEO_STATE_DATA_IN;
    break; 
    case VIDEO_STATE_DATA_IN:    
//      result = USBH_LL_GetURBState(phost, VIDEO_Handle->camera.Pipe);    VIDEO_Handle->camera.Pipe    
       result = usbh_urbstate_get (&usbh_core, VIDEO_Handle->camera.Pipe);
        
      if((result == URB_DONE) && ((phost->control.timer - VIDEO_Handle->camera.timer) >= VIDEO_Handle->camera.Poll))
      {
        VIDEO_Handle->camera.timer = phost->control.timer;    
        
        volatile uint32_t rxlen = usbh_xfercount_get (&usbh_core, VIDEO_Handle->camera.Pipe);         // picture_data[2][10240]
                  
        if (rxlen > 12)
        {
            if ( 0 == start_flag )
            {
                if (( 0xff == tmp_packet_framebuffer[12] )&& ( 0xd8 == tmp_packet_framebuffer[13] ))  
                {
                    data_length = 0 ;
                    start_flag = 1 ;
                    memcpy(&picture_data[cur_index][data_length],(void *)&tmp_packet_framebuffer[12],rxlen-12);
                    data_length = rxlen-12 ;
                }
            }
            else
            {
                  memcpy(&picture_data[cur_index][data_length],(void *)&tmp_packet_framebuffer[12],rxlen-12);
              
                  data_length +=  rxlen-12;
              
                  if (data_length > 20000)
                  {
                      data_length = 0 ;
                      start_flag = 0 ;
                      cur_index = 0 ;
                  }
              
                  if ((0xff == tmp_packet_framebuffer[rxlen-2])&&(0xd9 == tmp_packet_framebuffer[rxlen-1]))
                  {
                      finish_flag = 1 ;
                      send_length = data_length ;
                      send_index = cur_index ;
                      start_flag = 0 ;
                                        
                      if ( 0 == cur_index)
                        cur_index = 1;
                      else
                        cur_index = 0 ;
                      
                      xSemaphoreGiveFromISR( xSendSemaphore, &xHigherPriorityTaskWoken );

                       if( xHigherPriorityTaskWoken != pdFALSE )
                        {
                            // We can force a context switch here.  Context switching from an
                            // ISR uses port specific syntax.  Check the demo task for your port
                            // to find the syntax required.
                             portYIELD_FROM_ISR( xHigherPriorityTaskWoken );
                        }                                            
                  }
                 if (( 0xff == tmp_packet_framebuffer[12] )&& ( 0xd8 == tmp_packet_framebuffer[13] )) 
                  {
                    data_length = 0 ;
                    memcpy(&picture_data[cur_index][data_length],(void *)&tmp_packet_framebuffer[12],rxlen-12);
                    data_length = rxlen-12 ;                  
                  }                                
            }        
        }
                 
        usbh_data_recev (&usbh_core, (uint8_t*)tmp_packet_framebuffer, VIDEO_Handle->camera.Pipe,1000);
        
      }
    break;
    
    default:
      break;
  }
   
  return status;  
}
#endif

/**
  * @brief  USBH_VIDEO_SOFProcess 
  *         The function is for managing the SOF callback
  * @param  phost: Host handle
  * @retval USBH Status
  */
static usbh_status USBH_VIDEO_SOFProcess (usbh_host *phost)
{    
  return USBH_OK;
}

usbh_status USBH_VS_SetCur(usbh_host *phost, uint16_t request_type)
{
  uint16_t wLength = 26;
  
  
  if (request_type == (VS_PROBE_CONTROL << 8))
  {   
    memset(&ProbeParams, 0, sizeof(ProbeParams));
    // Set needed params, at commit stage this parameters must be receied during "GET_CUR"
    ProbeParams.bmHint = 1;
    ProbeParams.bFormatIndex = USBH_VIDEO_Best_bFormatIndex;             
    ProbeParams.bFrameIndex = USBH_VIDEO_Best_bFrameIndex;
    
    //Maximum framerate can be selected here
   // ProbeParams.dwFrameInterval = 333333;//30 FPS
    //ProbeParams.dwFrameInterval = 2000000;//5 FPS
      ProbeParams.dwFrameInterval = 1000000;//10 FPS
     // ProbeParams.dwFrameInterval = 500000;//20 FPS
     //ProbeParams.dwFrameInterval = 666666;//15 FPS
    //ProbeParams.dwFrameInterval = 400000;//25 FPS
  }

  
  //H2D - host to device
  phost->control.setup.req.bmRequestType = USB_H2D | USB_REQ_RECIPIENT_INTERFACE | \
  USB_REQ_TYPE_CLASS;
  
  VIDEO_HandleTypeDef *VIDEO_Handle;
  VIDEO_Handle =  (VIDEO_HandleTypeDef *) phost->active_class->class_data;
  
  phost->control.setup.req.bRequest = UVC_SET_CUR;
  phost->control.setup.req.wValue = request_type;
  phost->control.setup.req.wIndex = VIDEO_Handle->camera.interface; //Video Streaming interface number
  phost->control.setup.req.wLength = wLength;
  
  
    usbh_status status = USBH_BUSY;

    usbh_control *usb_ctl = &phost->control;

    if (CTL_IDLE == usb_ctl->ctl_state) {
        usb_ctl->setup.req = (usb_req) {
            .bmRequestType = 0x21,    //0x21  USB_TRX_OUT | USB_RECPTYPE_DEV | USB_REQTYPE_STRD
            .bRequest      = UVC_SET_CUR,                                 //0x01
            .wValue        = request_type,               
            .wIndex        = VIDEO_Handle->camera.interface,
            .wLength       = wLength
        };
    
        usbh_ctlstate_config (phost, (uint8_t *)&ProbeParams, wLength);    
    }
    
    do
    {
         status = usbh_ctl_handler (phost);
    }while(status == USBH_BUSY);
     
    return status;  
}

usbh_status USBH_VS_GetCur(usbh_host *phost, uint16_t request_type)
{
  memset(&ProbeParams, 0, sizeof(ProbeParams));
  uint16_t wLength = 26;

  //H2D - host to device
  phost->control.setup.req.bmRequestType = USB_D2H | USB_REQ_RECIPIENT_INTERFACE | USB_REQ_TYPE_CLASS ;     //
  
  
  VIDEO_HandleTypeDef *VIDEO_Handle;
  VIDEO_Handle =  (VIDEO_HandleTypeDef *) phost->active_class->class_data;   //phost->active_class->class_data
  
  phost->control.setup.req.bRequest = UVC_GET_CUR;    //0x81
  phost->control.setup.req.wValue = request_type;    //0x0100
  phost->control.setup.req.wIndex = VIDEO_Handle->camera.interface; //Video Streaming interface number  0x01
  phost->control.setup.req.wLength = wLength;   //0x1A
  
    usbh_status status = USBH_BUSY;

    usbh_control *usb_ctl = &phost->control;
  
    if (CTL_IDLE == usb_ctl->ctl_state) {
        usb_ctl->setup.req = (usb_req) {
            .bmRequestType = 0xA1,    //0x21  USB_TRX_OUT | USB_RECPTYPE_DEV | USB_REQTYPE_STRD
            .bRequest      = UVC_GET_CUR,                                 //0x01
            .wValue        = request_type,               
            .wIndex        = VIDEO_Handle->camera.interface,
            .wLength       = wLength
        };
  
        
        usbh_ctlstate_config (phost, (uint8_t *)&ProbeParams, wLength);
    }
      
    do
    {
         status = usbh_ctl_handler (phost);
    }while(status == USBH_BUSY);  
    
  if (status == USBH_OK)
  {
    if (ProbeParams.dwMaxVideoFrameSize > 0)
    {      
      return USBH_OK;
    }
    else
      return USBH_FAIL;
  }
  
  return status;
}


int calc_exposure_idx(int value)
{
    return value + 13;
}

//#define EXPO_MODE_AUTO      0x08
//#define EXPO_MODE_MANUAL    0x01
/* 设置曝光模式函数 */
usbh_status uvc_set_exposure_mode(usbh_host *phost, uint8_t mode)
{
    if ((mode != EXPO_MODE_AUTO)&&(mode != EXPO_MODE_MANUAL))
      return USBH_FAIL;
  
      usbh_status status = USBH_BUSY;
      
    VIDEO_HandleTypeDef *VIDEO_Handle;
  VIDEO_Handle =  (VIDEO_HandleTypeDef *) phost->active_class->class_data;   

    usbh_control *usb_ctl = &phost->control;

    if (CTL_IDLE == usb_ctl->ctl_state) {   // 21 01 00 02 00 01 01 00
        usb_ctl->setup.req = (usb_req) {
            .bmRequestType = 0x21,    //0x21  USB_TRX_OUT | USB_RECPTYPE_DEV | USB_REQTYPE_STRD
            .bRequest      = UVC_SET_CUR,                                 //0x01
            .wValue        = 0x02 << 8,               
            .wIndex        = 0x01 << 8,   //VIDEO_Handle->camera.interface,
            .wLength       = 1
        };

        usbh_ctlstate_config (phost, &mode, 1);    
        
        do
        {
            cnt++;
             status = usbh_ctl_handler (phost);
          
            if (cnt >= NUM)
            {
              cnt = 0 ;
              break;
            }
        }while(status == USBH_BUSY);          
    };      
              
    return status ;
}

/* 获取曝光模式函数 */
usbh_status uvc_get_exposure_mode(usbh_host *phost,uint8_t *mode)
{
    usbh_status status = USBH_BUSY;
    __IO usb_urb_state result;
  
    VIDEO_HandleTypeDef *VIDEO_Handle;
    VIDEO_Handle =  (VIDEO_HandleTypeDef *) phost->active_class->class_data;   

    usbh_control *usb_ctl = &phost->control;

    *mode = 0 ;
    if (CTL_IDLE == usb_ctl->ctl_state) {   // 0000   a1 81 00 02 00 01 01 00
        usb_ctl->setup.req = (usb_req) {
            .bmRequestType = 0xa1,    //0x21  USB_TRX_OUT | USB_RECPTYPE_DEV | USB_REQTYPE_STRD
            .bRequest      = 0x81,                                 //0x01
            .wValue        = 0x02 << 8,               
            .wIndex        = 0x1<<8,   //VIDEO_Handle->camera.interface,
            .wLength       = 1
        };
        
        usbh_ctlstate_config (phost, mode, 1);    
              
        do
        {
            cnt++;
             status = usbh_ctl_handler (phost);
          
            if (cnt >= NUM)
            {
              cnt = 0 ;
              break;
            }
        }while(status == USBH_BUSY);        
    };      
        
    result = usbh_urbstate_get (&usbh_core, phost->control.pipe_in_num);

      if(result == URB_DONE)
      {        
          volatile uint32_t rxlen = usbh_xfercount_get (&usbh_core, phost->control.pipe_in_num);

          printf("\r\nrxlen = %d mode = %d \r\n",rxlen,*mode);
      }
    
    return status ;
}


/* 设置曝光值函数 */
usbh_status uvc_set_exposure(usbh_host *phost, uint32_t exposure_val)
{  
      uint8_t exposure_data[4];
      usbh_status status = USBH_BUSY;
      
    VIDEO_HandleTypeDef *VIDEO_Handle;
  VIDEO_Handle =  (VIDEO_HandleTypeDef *) phost->active_class->class_data;   

    usbh_control *usb_ctl = &phost->control;

    if (CTL_IDLE == usb_ctl->ctl_state) {
        usb_ctl->setup.req = (usb_req) {
            .bmRequestType = 0x21,    //0x21  USB_TRX_OUT | USB_RECPTYPE_DEV | USB_REQTYPE_STRD
            .bRequest      = UVC_SET_CUR,                                 //0x01
            .wValue        = 0x04 << 8,               
            .wIndex        = VIDEO_Handle->camera.interface<<8 ,  //VIDEO_Handle->camera.interface << 8
            .wLength       = 4
        };
       //0x 0000 0271
       exposure_data[0] = (uint8_t)(exposure_val & 0xFF);
       exposure_data[1] = (uint8_t)((exposure_val >> 8) & 0xFF);
       exposure_data[2] = (uint8_t)((exposure_val >> 16) & 0xFF);
       exposure_data[3] = (uint8_t)((exposure_val >> 24) & 0xFF);  
              
        usbh_ctlstate_config (phost, (uint8_t *)&exposure_data, 4);  
              
        do
        {
            cnt++;
             status = usbh_ctl_handler (phost);
          
            if (cnt >= NUM)
            {
              printf("uvc_set_exposure timeout \r\n");
              cnt = 0 ;
              break;
            }
        }while(status == USBH_BUSY);        
        
    }  
        
    return status ;
}

/* 获取曝光值函数 */
usbh_status uvc_get_exposure(usbh_host *phost, float exposure_val)
{  
      usbh_status status = USBH_BUSY;
      
    VIDEO_HandleTypeDef *VIDEO_Handle;
  VIDEO_Handle =  (VIDEO_HandleTypeDef *) phost->active_class->class_data;   

    usbh_control *usb_ctl = &phost->control;

    uint8_t val[4];
  
  
    if (CTL_IDLE == usb_ctl->ctl_state) {   //a1 81 00 04 00 01 04 00
        usb_ctl->setup.req = (usb_req) {
            .bmRequestType = 0xa1,    //0x21  USB_TRX_OUT | USB_RECPTYPE_DEV | USB_REQTYPE_STRD
            .bRequest      = UVC_GET_CUR,                                 //0x01
            .wValue        = 0x04 << 8,               
            .wIndex        = VIDEO_Handle->camera.interface << 8,
            .wLength       = 4
        };  

        usbh_ctlstate_config (phost, val, 4);    

        do
        {
            cnt++;
             status = usbh_ctl_handler (phost);
          
            if (cnt >= NUM)
            {
              cnt = 0 ;
              break;
            }
        }while(status == USBH_BUSY);        
    };      
    
    if (status == USBH_OK)
    {
        exposure_val  = val[0] | val[1]<<8 | val[2]<<16 |  val[3]<<24 ;
    }
      
    return status ;
}

/* 设置亮度函数 */
usbh_status uvc_set_brightness(usbh_host *phost, int brightness_val)
{
      usbh_status status = USBH_BUSY;
      
    VIDEO_HandleTypeDef *VIDEO_Handle;
  VIDEO_Handle =  (VIDEO_HandleTypeDef *) phost->active_class->class_data;   

    usbh_control *usb_ctl = &phost->control;
   
//    printf("uvc_set_brightness usb_ctl->ctl_state = %d\r\n",usb_ctl->ctl_state);
    if (CTL_IDLE == usb_ctl->ctl_state) {   //21 01 00 02 00 02 02 00
        usb_ctl->setup.req = (usb_req) {
            .bmRequestType = 0x21,    //0x21  USB_TRX_OUT | USB_RECPTYPE_DEV | USB_REQTYPE_STRD
            .bRequest      = UVC_SET_CUR,                                 //0x01
            .wValue        = 0x02 << 8,               
            .wIndex        = 0x2 << 8,
            .wLength       = 2
        };
       //0x 0000 0271
      uint8_t brightness[2] = {
        (uint8_t)(brightness_val & 0xFF),
        (uint8_t)((brightness_val >> 8) & 0xFF),
    };      
        usbh_ctlstate_config (phost, (uint8_t *)&brightness, 2);    
    
        do
        {
//            cnt++;
             status = usbh_ctl_handler (phost);
          
//            if (cnt >= NUM)
//            {
//              cnt = 0 ;
//              break;
//            }
        }while(status == USBH_BUSY);      
    }  
      
    return status;
}


usbh_status uvc_get_brightness(usbh_host *phost, int brightness_val)
{
    return USBH_BUSY;
}


/* 设置逆光对比度函数 */
usbh_status uvc_set_backlight(usbh_host *phost, uint8_t backlight_val)
{
      usbh_status status = USBH_BUSY;
      
    if (backlight_val > 5)
      return USBH_OK;
  
  
    VIDEO_HandleTypeDef *VIDEO_Handle;
  VIDEO_Handle =  (VIDEO_HandleTypeDef *) phost->active_class->class_data;   

    usbh_control *usb_ctl = &phost->control;
   
//    printf("uvc_set_brightness usb_ctl->ctl_state = %d\r\n",usb_ctl->ctl_state);
    if (CTL_IDLE == usb_ctl->ctl_state) {   //21 01 00 02 00 02 02 00
        usb_ctl->setup.req = (usb_req) {
            .bmRequestType = 0x21,    //0x21  USB_TRX_OUT | USB_RECPTYPE_DEV | USB_REQTYPE_STRD
            .bRequest      = UVC_SET_CUR,                                 //0x01
            .wValue        = 0x01 << 8,               
            .wIndex        = 0x2 << 8,
            .wLength       = 2
        };
       //0x 0000 0271
      uint8_t backlight[2] = { backlight_val,0x00};      
        usbh_ctlstate_config (phost, (uint8_t *)&backlight, 2);    
    
        do
        {
//            cnt++;
             status = usbh_ctl_handler (phost);
          
//            if (cnt >= NUM)
//            {
//              cnt = 0 ;
//              break;
//            }
        }while(status == USBH_BUSY);      
    }  
      
    return status;
}

/* 设置增益函数 */
usbh_status uvc_set_gain(usbh_host *phost, uint8_t gain_val)
{
      usbh_status status = USBH_BUSY;
        
    VIDEO_HandleTypeDef *VIDEO_Handle;
  VIDEO_Handle =  (VIDEO_HandleTypeDef *) phost->active_class->class_data;   

    usbh_control *usb_ctl = &phost->control;
   
//    printf("uvc_set_brightness usb_ctl->ctl_state = %d\r\n",usb_ctl->ctl_state);
    if (CTL_IDLE == usb_ctl->ctl_state) {   //21 01 00 02 00 02 02 00
        usb_ctl->setup.req = (usb_req) {
            .bmRequestType = 0x21,    //0x21  USB_TRX_OUT | USB_RECPTYPE_DEV | USB_REQTYPE_STRD
            .bRequest      = UVC_SET_CUR,                                 //0x01
            .wValue        = 0x04 << 8,               
            .wIndex        = 0x2 << 8,
            .wLength       = 2
        };
       //0x 0000 0271
      uint8_t gain[2] = { gain_val,0x00};      
        usbh_ctlstate_config (phost, (uint8_t *)&gain, 2);    
    
        do
        {
//            cnt++;
             status = usbh_ctl_handler (phost);
          
//            if (cnt >= NUM)
//            {
//              cnt = 0 ;
//              break;
//            }
        }while(status == USBH_BUSY);      
    }  
      
    return status;
}


//#define  UVC_CTL_SET_EM_MODE   1  
//#define  UVC_CTL_SET_EM_VAL    2
//#define  UVC_CTL_SET_BN_VAL    3
//#define  UVC_CTL_GET_EM_MODE   4
//#define  UVC_CTL_GET_EM_VAL    5
//#define  UVC_CTL_GET_BN_VAL    6
void uvc_ctl_task(void *arg)
{
			usbh_status status ;
			int idx;
			static int time = 0 ;
			usbh_host *uhost = (usbh_host *)arg;
					if ( 1 == sys_para.video.ctl_state)
					{
							switch (sys_para.video.ctl_val)
							{
								case UVC_CTL_SET_EM_MODE:  //设置曝光模式
								status = uvc_set_exposure_mode(uhost, sys_para.video.exposure_mode);
								
								if ( USBH_OK == status)
								{
										sys_para.video.ctl_val = 0 ;
										sys_para.video.ctl_state = 0 ;
								}								
								break;
								case UVC_CTL_SET_EM_VAL:  //设置曝光值
											status = uvc_set_exposure_mode(uhost, 1);
										  
//											if ( USBH_OK == status)
//											{
//													  status = uvc_get_exposure_mode(uhost, &tmp);
												
//														if (tmp == 8)
//															status = uvc_set_exposure_mode(uhost, 1);
														
														if ( USBH_OK == status)
														{
																idx = calc_exposure_idx(sys_para.video.exposure_level);
															
																status = uvc_set_exposure(uhost, exposure_val[idx]);
																vTaskDelay(500);
																if ( USBH_OK == status)
																{
																		sys_para.video.ctl_val = 0 ;
																		sys_para.video.ctl_state = 0 ;
																}											
														}													
//											}																											
								break;
								case UVC_CTL_SET_BN_VAL:  //设置亮度值
									status =  uvc_set_brightness(uhost, sys_para.video.brightness_val);
								
									if ( USBH_OK == status)
									{
											sys_para.video.ctl_val = 0 ;
											sys_para.video.ctl_state = 0 ;
									}	
								break;
								case UVC_CTL_SET_BL_VAL:  //设置逆光对比度
									status =  uvc_set_backlight(uhost, sys_para.video.backlight_val);
								
									if ( USBH_OK == status)
									{
											sys_para.video.ctl_val = 0 ;
											sys_para.video.ctl_state = 0 ;
									}	
								break;	
								case UVC_CTL_SET_GN_VAL:  //设置逆光对比度
									status =  uvc_set_gain(uhost, sys_para.video.gain_val);
								
									if ( USBH_OK == status)
									{
											sys_para.video.ctl_val = 0 ;
											sys_para.video.ctl_state = 0 ;
									}	
								break;									
								case UVC_CTL_GET_EM_MODE:  //获取当前曝光模式
								status = uvc_get_exposure_mode(uhost, &sys_para.video.exposure_mode);
								if ( USBH_OK == status)
								{
										sys_para.video.ctl_val = 0 ;
										sys_para.video.ctl_state = 0 ;
								}								
								break;
								case UVC_CTL_GET_EM_VAL:  //获取曝光值
									status = uvc_get_exposure(uhost, sys_para.video.exposure_level);
									if ( USBH_OK == status)
									{
											sys_para.video.ctl_val = 0 ;
											sys_para.video.ctl_state = 0 ;
									}									
								break;
								case UVC_CTL_GET_BN_VAL:  //获取当前亮度值
									status =  uvc_get_brightness(uhost, (int)sys_para.video.brightness_val);
								
									if ( USBH_OK == status)
									{
											sys_para.video.ctl_val = 0 ;
											sys_para.video.ctl_state = 0 ;
									}	
								break;									
								default:
									sys_para.video.ctl_state = 0 ;
								  sys_para.video.ctl_val = 0 ;
								break;
							}					
					}	
					
					time++;
					
					if (time >=5)
					{
							time = 0 ;
							sys_para.video.ctl_state = 0 ;
							sys_para.video.ctl_val = 0 ;						
					}
}



#if 0
usbh_status USBH_VS_SetCur(usbh_host *phost, uint16_t request_type)
{
  uint16_t wLength = 26;
  
  if (request_type == (VS_PROBE_CONTROL << 8))
  {
    memset(&ProbeParams, 0, sizeof(ProbeParams));
    // Set needed params, at commit stage this parameters must be receied during "GET_CUR"
    ProbeParams.bmHint = 1;
    ProbeParams.bFormatIndex = USBH_VIDEO_Best_bFormatIndex;             
    ProbeParams.bFrameIndex = USBH_VIDEO_Best_bFrameIndex;
    
    //Maximum framerate can be selected here
    ProbeParams.dwFrameInterval = 333333;//30 FPS
    //ProbeParams.dwFrameInterval = 2000000;//5 FPS
  }
  
  //H2D - host to device
  phost->control.setup.req.bmRequestType = USB_H2D | USB_REQ_RECIPIENT_INTERFACE | \
  USB_REQ_TYPE_CLASS;
  
  VIDEO_HandleTypeDef *VIDEO_Handle;
  VIDEO_Handle =  (VIDEO_HandleTypeDef *) phost->active_class->class_data;
  
  phost->control.setup.req.bRequest = UVC_SET_CUR;
  phost->control.setup.req.wValue = request_type;
  phost->control.setup.req.wIndex = VIDEO_Handle->camera.interface; //Video Streaming interface number
  phost->control.setup.req.wLength = wLength;
  
  usbh_status status;
  do 
  {
//    status = USBH_CtlReq(phost, (uint8_t *)&ProbeParams, wLength);
        //status = usbh_ctlsetup_send ((usb_core_driver *)phost->data, (uint8_t *)&ProbeParams, wLength);
    
    status = usbh_ctlsetup_send (&usbh_core, (uint8_t *)&ProbeParams, wLength);

        //status = usbh_ctl_handler (phost);      
  } while (status == USBH_BUSY);
  
  return USBH_OK;
}


usbh_status USBH_VS_GetCur(usbh_host *phost, uint16_t request_type)
{
  memset(&ProbeParams, 0, sizeof(ProbeParams));
  uint16_t wLength = 26;

  //H2D - host to device
  phost->control.setup.req.bmRequestType = USB_D2H | USB_REQ_RECIPIENT_INTERFACE | USB_REQ_TYPE_CLASS ;     //
  
  
  VIDEO_HandleTypeDef *VIDEO_Handle;
  VIDEO_Handle =  (VIDEO_HandleTypeDef *) phost->active_class->class_data;   //phost->active_class->class_data
  
  phost->control.setup.req.bRequest = UVC_GET_CUR;    //0x81
  phost->control.setup.req.wValue = request_type;    //0x0100
  phost->control.setup.req.wIndex = VIDEO_Handle->camera.interface; //Video Streaming interface number  0x01
  phost->control.setup.req.wLength = wLength;   //0x1A
  
  usbh_status  status;
  do 
  {
    //status = USBH_CtlReq(phost, (uint8_t *)&ProbeParams, wLength);
    
//    status = usbh_ctlsetup_send ((usb_core_driver *)phost->data, 
//                        phost->control.setup.data, 
//                        phost->control.pipe_out_num);
    
    status = usbh_ctlsetup_send (&usbh_core, phost->control.setup.data,phost->control.pipe_out_num);
                                          
    //status = usbh_ctl_handler (phost);
    
    //usbh_ctl_handler (usbh_host *uhost);
  } while (status == USBH_BUSY);
  
  if (status == USBH_OK)
  {
    if (ProbeParams.dwMaxVideoFrameSize > 0)
    {
      return USBH_OK;
    }
    else
      return USBH_FAIL;
  }
  
  return status;
}
#endif

/*
 * user callbak definition
*/ 
void USBH_UserProcess(usbh_host *phost, uint8_t id)
{
  /* USER CODE BEGIN 2 */
  switch(id)
  { 
  case HOST_USER_CLASS_SELECTED:
    { 
      usbh_status  status;  
      status = USBH_VS_SetCur(phost, VS_PROBE_CONTROL << 8);
      
      status = USBH_VS_GetCur(phost, VS_PROBE_CONTROL << 8);
          
      if (status == USBH_OK)
      {
            USBH_VS_SetCur(phost, VS_COMMIT_CONTROL << 8);
            //USBH_VS_GetCur_test(phost, VS_COMMIT_CONTROL << 8);
    //        status = USBH_VS_GetCur(phost, VS_COMMIT_CONTROL << 8);// not necessary
      }      
    
    }
    break;
    
  case HOST_USER_SELECT_CONFIGURATION:
    break;
    
  case HOST_USER_DISCONNECTION:
    Appli_state = APPLICATION_DISCONNECT;
    break;
    
  case HOST_USER_CLASS_ACTIVE:
    Appli_state = APPLICATION_READY;
    break;
    
  case HOST_USER_CONNECTION:
    Appli_state = APPLICATION_START;
    break;
  case HOST_USER_SET_BACKLIGHT:
    uvc_set_backlight(phost, sys_para.video.backlight_val);
    break;
  case  HOST_USER_SET_GAIN:
    uvc_set_gain(phost, sys_para.video.gain_val);
    break;
  default:
    break; 
  }
  /* USER CODE END 2 */
}

void timer11_handler(void) {
    BaseType_t xHigherPriorityTaskWoken = pdFALSE;
    int result;
    DEFINE_CPU_SR;

    ENTER_ISR();
    if (timer_flag_get(TIMER11, TIMER_FLAG_UP) == SET) {
        result = USBH_VIDEO_Process(&usb_host_uvc);
        
        if (1 == result ){
            xSemaphoreGiveFromISR( xSendSemaphore, &xHigherPriorityTaskWoken );

         if( xHigherPriorityTaskWoken != pdFALSE ){
                    // We can force a context switch here.  Context switching from an
                    // ISR uses port specific syntax.  Check the demo task for your port
                    // to find the syntax required.
                     portYIELD_FROM_ISR( xHigherPriorityTaskWoken );
            }
        }
            timer_flag_clear(TIMER11, TIMER_FLAG_UP); /* ack irq */
        }
    
    EXIT_ISR();
}


//ostimer_register(OSTIMER_CAMERA_TASK, camera_task, (void *)0, AGENT_PRIO_HI, CAMERA_TASK_RATE_HZ);

#if  1 
void data_send_task(void *arg) {
        static int send_frequency = 1;
       // See if we can obtain the semaphore.  If the semaphore is not available
       // wait 10 ticks to see if it becomes free.
		while (1)
		{
      if( xSemaphoreTake( xSendSemaphore, portMAX_DELAY) == pdTRUE )
      {
										fwdgt_counter_reload();  // 分块后喂狗
  #if 1                  
                    /* 构建单帧边界头和图像内容 */
                    const char *frame_header = "\r\n--boundarydonotcross\r\n"
                                               "Content-Type: image/jpeg\r\n"
                                               "Content-Length: %5d\r\n\r\n";
                    char        header_buf[128];
                    int         header_len = snprintf(header_buf, sizeof(header_buf), frame_header, send_length);
										
										/* 视频关闭时直接跳过发送 */
										if (sys_para.video.video_control == 0) {
											continue;
										}
                                        if(sys_para.video.video_send_fre != 0){
                                            if((send_frequency++ % sys_para.video.video_send_fre) != 0){ 
                                                continue;
                                            }
                                            send_frequency = 1;
                                        }
                                        

                    /* 每帧发送数据 */										
										uint8_t *p = &picture_data[0][0];
										
										if (send_index == 0)
										{
												p = p - header_len ;
									      // memcpy(p, header_buf, header_len);									
										}
										else 
										{
												p = p + PIC_SIZE - header_len ;	
										}
                                        ENTER_CRITICAL();
										  memcpy(p, header_buf, header_len);
                                        EXIT_CRITICAL();
                                        int len = header_len + send_length;
                                        int send_count = len / sys_para.video.send_size_test;
                                        if(len % sys_para.video.send_size_test != 0){
                                            send_count++;
                                        }
                                        int send_len_once = 0;
                                        while(send_count--){
                                            send_len_once = 0;
                                            if(len >= sys_para.video.send_size_test){
                                                send_len_once = sys_para.video.send_size_test;
                                                len = len - send_len_once;
                                            }else{
                                                send_len_once = len;
                                                len = 0;
                                            }
                                            ENTER_CRITICAL();
                                            tcp_server_send_low(sys_state.camera_client_num, p,send_len_once);
                                            EXIT_CRITICAL();
                                            if(len > 0){
                                                TickType_t xLastWakeTime = xTaskGetTickCount();
                                                vTaskDelayUntil(&xLastWakeTime,pdMS_TO_TICKS(sys_para.video.test_delay));
                                            }
                                            
                                            p = p + send_len_once;
                                            
                                            
                                        }
                        
												//EXIT_CRITICAL();
									fwdgt_counter_reload();  // 分块后喂狗
	#else								
													//	char *send  ="123456789\r\n";
										
                 	tcp_server_send_low(sys_state.camera_client_num, send,sizeof(send));					
		#endif		

       }
       else {
           // We could not obtain the semaphore and can therefore not access
           // the shared resource safely.
       }
    }
}
#else
void data_send_task(void *arg) {
                if ( finish_flag == 1 ){
									finish_flag = 0 ;

  #if 1                  
                    /* 构建单帧边界头和图像内容 */
                    const char *frame_header = "\r\n--boundarydonotcross\r\n"
                                               "Content-Type: image/jpeg\r\n"
                                               "Content-Length: %5d\r\n\r\n";
                    char        header_buf[128];
                    int         header_len = snprintf(header_buf, sizeof(header_buf), frame_header, send_length);
										
										                    /* 每帧发送数据 */

                    /* 每帧发送数据 */										
										uint8_t *p = &picture_data[0][0];
										
										if (send_index == 0)
										{
												p = p - header_len ;
									      // memcpy(p, header_buf, header_len);
											
										}
										else 
										{
												p = p + PIC_SIZE - header_len ;	
										}
										
										memcpy(p, header_buf, header_len);
									
									tcp_server_send_low(sys_state.camera_client_num, p,header_len + send_length);
	#else								
													//	char *send  ="123456789\r\n";
										
                 	tcp_server_send_low(sys_state.camera_client_num, send,sizeof(send));					
		#endif								
										
                }

}
#endif

